arduino_i2c: &i2c2 {
        compatible = "nordic,nrf-twim";
        status = "okay";
        sda-pin = <30>;
        scl-pin = <31>;
        clock-frequency = <I2C_BITRATE_FAST>;
        zephyr,concat-buf-size = <1024>;
    
            ssd1306@3c {
            compatible = "solomon,ssd1306fb";
            reg = <0x3c>;
            label = "SSD1306";
            width = <128>;
            height = <32>;
            segment-offset = <0>;
            page-offset = <0>;
            display-offset = <0>;
            multiplex-ratio = <31>; 
            segment-remap;
            com-invdir;
            com-sequential;
            prechargep = <0x22>;
             
            
    
    
        };
};