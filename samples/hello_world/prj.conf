## CMakeLists.txt
```
# SPDX-License-Identifier: Apache-2.0

cmake_minimum_required(VERSION 3.13.1)

set(mcuboot_OVERLAY_CONFIG                # Add this line
  ${CMAKE_CURRENT_LIST_DIR}/mcuboot.conf  # Add this line
)                                     # Add this line

find_package(Zephyr REQUIRED HINTS $ENV{ZEPHYR_BASE})
project(hello_world)

target_sources(app PRIVATE src/main.c)
```

## prj.conf
```kconfig
# Enable mcumgr.
CONFIG_MCUMGR=y

# Enable most core commands.
CONFIG_MCUMGR_CMD_IMG_MGMT=y
CONFIG_MCUMGR_CMD_OS_MGMT=y

# Ensure an MCUboot-compatible binary is generated.
CONFIG_BOOTLOADER_MCUBOOT=y

# Enable the serial mcumgr transport.
CONFIG_MCUMGR_SMP_UART=y

# Disable UART Console and enable the RTT console
CONFIG_UART_CONSOLE=n
CONFIG_RTT_CONSOLE=y
CONFIG_USE_SEGGER_RTT=y

# Some command handlers require a large stack.
CONFIG_SYSTEM_WORKQUEUE_STACK_SIZE=4096

CONFIG_NORDIC_QSPI_NOR=y
CONFIG_NORDIC_QSPI_NOR_FLASH_LAYOUT_PAGE_SIZE=4096
CONFIG_NORDIC_QSPI_NOR_STACK_WRITE_BUFFER_SIZE=16
```

## mcuboot.conf
```kconfig
CONFIG_PM_PARTITION_SIZE_MCUBOOT=0x10000
```

## nrf52dk_nrf52832.overlay
```dts
&spi2 {
	compatible = "nordic,nrf-spim";
	status = "okay";
	sck-pin = <31>;
	mosi-pin = <30>;
	miso-pin = <29>;
	cs-gpios = <&gpio0 28 2>;
};
       
```

## nrf9160dk_nrf9160_ns.overlay
```dts
/ {
    vdd_pwr: vdd-pwr-ctrl {
        compatible = "regulator-fixed-sync", "regulator-fixed";
        label = "vdd-pwr-ctrl";
        regulator-name = "vdd-pwr-ctrl";
        enable-gpios = <&gpio0 2 GPIO_ACTIVE_HIGH>;
        regulator-boot-on;
    };
};
```

## src/main.c
```c
/*
 * Copyright (c) 2012-2014 Wind River Systems, Inc.
 *
 * SPDX-License-Identifier: Apache-2.0
 */

#include <zephyr.h>
#include <sys/printk.h>
#include "os_mgmt/os_mgmt.h"
#include "img_mgmt/img_mgmt.h"

void main(void)
{
	printk("Hello World! %s\n", CONFIG_BOARD);
	printk("build time: " __DATE__ " " __TIME__ "\n");
	os_mgmt_register_group();
	img_mgmt_register_group();
}
```
