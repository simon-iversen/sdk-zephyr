## samples/application_development/out_of_tree_board/boards/arm/tindeq_nrf52832/Kconfig.board
```kconfig
# TINDEQ NRF52832 board configuration

# Copyright (c) 2016 Nordic Semiconductor ASA
# SPDX-License-Identifier: Apache-2.0

config BOARD_TINDEQ_NRF52832
	bool "TINDEQ NRF52832"
	depends on SOC_NRF52832_QFAA
```

## samples/application_development/out_of_tree_board/boards/arm/tindeq_nrf52832/Kconfig.defconfig
```kconfig
# TINDEQ NRF52832 board configuration

# Copyright (c) 2016 Nordic Semiconductor ASA
# SPDX-License-Identifier: Apache-2.0

if BOARD_TINDEQ_NRF52832

config BOARD
	default "tindeq_nrf52832"

config BT_CTLR
	default BT

endif # BOARD_TINDEQ_NRF52832
```
